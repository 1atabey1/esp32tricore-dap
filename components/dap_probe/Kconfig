## components/dap_probe/Kconfig
```kconfig
menu "Infineon DAP probe"

    config AEL_DAP_BRINGUP_CLOCK_HZ
        int "DAP bit rate for the CPU-path bring-up endpoints (Hz)"
        default 400000
        range 100000 4000000
        help
            Clock for /api/dap_bringup, /api/dap_spi and the trace endpoints'
            attach.  The bit-banged PHY tops out around 2 MHz.

endmenu
```
